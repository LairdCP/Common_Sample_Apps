## ess_demo/boards/pinnacle_100_dvk.conf
```kconfig
CONFIG_SENSOR=y
CONFIG_BME680=y
CONFIG_SPI=y

CONFIG_HEAP_MEM_POOL_SIZE=2048
CONFIG_MAIN_STACK_SIZE=2048
CONFIG_PRIVILEGED_STACK_SIZE=2048
CONFIG_SYSTEM_WORKQUEUE_STACK_SIZE=1024
CONFIG_IDLE_STACK_SIZE=512
CONFIG_ISR_STACK_SIZE=1024
CONFIG_KOBJECT_TEXT_AREA=512
```
